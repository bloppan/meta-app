## conf/machine/imx6ul-var-dart-app.conf
```bitbake
require conf/machine/imx6ul-var-dart.conf
MACHINEOVERRIDES_EXTENDER_imx6ul-var-dart-app = "imx6ul-var-dart"

KERNEL_DEVICETREE = "\
			imx6ull-var-dart-6ulcustomboard-emmc-wifi.dtb \
			imx6ull-var-dart-6ulcustomboard-emmc-sd-card.dtb \
			"
```

## wic/debug-wic.wks
```
# Image Creator .wks
part SPL --source rawcopy --sourceparams="file=SPL" --ondisk mmcblk --no-table --align 1
part u-boot --source rawcopy --sourceparams="file=u-boot.img" --ondisk mmcblk --no-table --align 69
# Boot partition
part /boot --source bootimg-partition --ondisk mmcblk --fstype=vfat --label boot --active --align 4096 --size 8M --extra-space 0
# Rootfs partition
part / --source rootfs --ondisk mmcblk --fstype=ext4 --label system --exclude-path=home/     
part /home --source rootfs --rootfs-dir=${IMAGE_ROOTFS}/home --ondisk mmcblk --fstype=vfat --label STORAGE --size 900M
```
